#include <Wire.h>
#include <Adafruit_GFX.h>
#include <Adafruit_SSD1306.h>

#define SCREEN_WIDTH 128
#define SCREEN_HEIGHT 64
#define OLED_RESET -1

Adafruit_SSD1306 display(SCREEN_WIDTH, SCREEN_HEIGHT, &Wire, OLED_RESET);

const unsigned char PROGMEM petHappy[] = {
  0b00000000, 0b00001111, 0b10000000, 0b00000000,
  0b00000000, 0b10000111, 0b10001100, 0b00111000,
  0b00011100, 0b01100111, 0b10011000, 0b00001100,
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  0b00000000, 0b00000000, 0b00000000, 0b00000000
};

const unsigned char PROGMEM petSad[] = {
  0b00000000, 0b00001111, 0b10000000, 0b00000000,
  0b00000000, 0b10000111, 0b10001100, 0b00000000,
  0b00000000, 0b01100111, 0b10011000, 0b00000000,
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  0b00000000, 0b00000000, 0b00000000, 0b00000110
};




const unsigned char PROGMEM peteep [] = {
  0b00000000, 0b00001111, 0b10000000, 0b00000000,
  0b00000000, 0b10000111, 0b10001100, 0b00000000,
  0b00000000, 0b01100111, 0b10011000, 0b00000000,
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  0b00000000, 0b00000000, 0b00000000, 0b00000000
};

const unsigned char PROGMEM petNeutral [] = {
 0b00000000, 0b00001111, 0b10000000, 0b00000000,
  0b00000000, 0b10000111, 0b10001100, 0b00000000,
  0b00000000, 0b01100111, 0b10011000, 0b00000000,
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  0b00000000, 0b00000000, 0b00000000, 0b00000000
};
};


//buttons
#define BTN_LEFT D0
#define BTN_MID D1
#define BTN3_RIGHT D2

//buzzer
#define BUZZER D11

//OLED
#define SDA_PIN D5
#define SCL_PIN D6

//NEOPIXELS
#define LED1 D8
#define LED2 D9

unsigned long lastUpdate = 0;
unsigned long lastButtonPress = 0;

struct pet{
  int hungryness;
  int happiness;
  int energy;
  unsigned long age;
}

enum Screen{
  SCREEN_MAIN,
  SCREEN_FEED,
  SCREEN_PLAY,
  SCREEN_SLEEP,
} 

Screen setcurrentscreen = SCREEN_MAIN;

void setup() {
  pinMode(BTN_LEFT, INPUT_PULLUP);
  pinMode(BTN_RIGHT, INPUT_PULLUP);
  pinMode(BTN_MIDDLE, INPUT_PULLUP);
  pinMode(BUZZER, OUTPUT);

  display.begin(SSD1306_SWITCHCAPVCC, 0x3c);
  display.clearDisplay();
  display.setTextSize(1);
  display .setTextColor(SSD1306_WHITE);
  display.println("Tamagotchi Init...")
  display.display();
  delay(1000);

  pet.hunger = 80;
  pet.happiness = 80;
  pet.energy = 80;
  pet.age = 0;

}

void updatePet(){
  if(millis() - lastUpdate > 5000){
    pet.hunger--;
    pet.happiness--;
    pet.energy--;

    if (pet.hunger < 0) pet.hunger = 0;
    if (pet.happiness < 0) pet.happiness = 0;
    if (pet.energy < 0) pet.energy = 0;

    pet.age += 5;
    lastUpdate = millis();
  }
}

void cButtons(){
  if (millis() - lastButtonPress < 200) return;

  if (digitalRead(BTN_LEFT) == LOW){
    currentScreen = SCREEN_FEED;
    tone (BUZZER_PIN, 1000, 50);
    lastButtonPress = millis();
  } else if (digitalRead(BTN_MIDDLE) == LOW){
    currentScreen = SCREEN_PLAY;
    tone(BUZZER_PIN, 1200,50);
    lastButtonPress = millis();
  } else if (digitalRead(BTN_RIGHT) == LOW){
    currrentScreen = SCREEN_SLEEP;
    tone(BUZZER_PIN, 1200, 50);
    lastButtonPress = millis();
  }
}

void handleScreen (){
  switch(currentScreen){

    case SCREEN_FEED:
    pet.hunger += 10;
    if (pet.hunger > 100) pet.hunger = 100;
    currentScreen = SCREEN_MAIN;
    break;

    case SCREEN_PLAY:
    pet.happiness += 10;
    if (pet.happiness > 100) pet.happiness = 100;
    currentScreen = SCREEN_MAIN;
    break;

    case SCREEN_SLEEP:
    pet.energy += 10;
    if (pet.energy > 100) pet.energy = 100;
    currentScreen = SCREEN_MAIN;
    break;

    case SCREEN_MAIN:
    break;
  }

}

void render(){
  display.clearDisplay();

  const unsigned char* sprite;
  if(pet.hunger < 30|| pet.happiness < 30 || pet.energy <30){
    sprite = petSad;
  } else if (pet.hunger > 60 && pet.happiness > 60 && pet.energy > 60){
    sprite = pethappy;
  } else {
    sprite = petNeutral
  }

  display.drawBitmap(56, 2, sprite, 32, 32, SSD1306_WHITE);
  display.setTextSize(1);

  display.setCursor(0,24);
  display.print("HUN: ");
  drawBar(24,24, pet.hunger);

  display.setCursor(0,34);
  display.print("HAP:");
  drawBar(24,24,pet.happiness);

  display.setCursor(0,44);
  display.print("EN:");
  drawBar(24,24,pet.energy);

  display.setCursor(0,56);
  display.println("[Feed] [Play] [Sleep]");

  display.display();
}

void drawBar (int x, int y, int value){
  int barWidth = 100;
  int barHeight = 100;
  int fillWidth = map(value,0,100,0, barWidth);

  display.drawRect(x, y, barWidth, barHeight, SSD1306_WHITE);
  display.fillRect(x, y, fillWidth, barHeight, SSD12-6_WHITE)
}

void loop() {
  cButtons();
  updatePet();
  handleScreen();
  render();
  delay(100);

}
